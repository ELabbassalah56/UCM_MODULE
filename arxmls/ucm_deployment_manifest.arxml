AUTOSAR XML (schema 00047)
package /ara/apd/ucm/deployment
  someip service interface deployment PackageManagementSomeIp: service-interface=PackageManagement, service-interface-id=629, service-interface-version={major-version=1, minor-version=0}
    someip field deployment CurrentStatus: field=CurrentStatus
      get CurrentStatus_getter: method-id=30005, transport-protocol=UDP
      notifier CurrentStatus_notifier: event-id=41206, transport-protocol=TCP
    18 x someip method deployment, all with transport-protocol=UDP:
      UCMInfoService: method=UCMInfoService, method-id=30180
      Activate: method=Activate, method-id=30140
      Cancel: method=Cancel, method-id=30120
      DeleteTransfer: method=DeleteTransfer, method-id=30080
      Finish: method=Finish, method-id=30150
      GetHistory: method=GetHistory, method-id=30200
      GetLog: method=GetLog, method-id=30170
      GetSwClusterChangeInfo: method=GetSwClusterChangeInfo, method-id=30000
      GetSwClusterInfo: method=GetSwClusterInfo, method-id=29900
      GetSwPackages: method=GetSwPackages, method-id=30020
      GetSwProcessProgress: method=GetSwProcessProgress, method-id=30110
      ProcessSwPackage: method=ProcessSwPackage, method-id=30090
      RevertProcessedSwPackages: method=RevertProcessedSwPackages, method-id=30100
      Rollback: method=Rollback, method-id=30130
      SetLogLevel: method=SetLogLevel, method-id=30160
      TransferData: method=TransferData, method-id=30060
      TransferExit: method=TransferExit, method-id=30070
      TransferStart: method=TransferStart, method-id=30050
    someip event group CurrentStatus_eventgroup: event-group-id=44404, event=CurrentStatus_notifier
