AUTOSAR XML (schema 00047)
package /ara/apd/ucm/executables
  executable package_manager: category=PLATFORM_LEVEL, build-type=BUILD-TYPE-DEBUG, minimum-timer-granularity=1000.0, version=1.0.0.0
    root sw component prototype package_manager_root: application-type=package_manager_swc
package /ara/apd/ucm/processes
  process package_manager: executable=package_manager, state-dependent-startup-config{execution-dependencys=[state_machine.Running, state_machine.Running], function-group-state=MachineState.Driving, resource-group=ResourceGroup1, startup-config=package_manager_startup}
    process state machine state_machine: type=ProcessStateMachine
package /ara/apd/ucm/software_components
  adaptive application sw component type package_manager_swc
    provide port PackageManagementPPort: provided-interface=PackageManagement
package /ara/apd/ucm/startup_configs
  startup config set startup_set
    startup config package_manager_startup: environment-variables=tag-with-optional-value={key=VSOMEIP_CONFIGURATION, value=/opt/package_manager/etc/vsomeip.json}, scheduling-policy=SCHEDULING-POLICY-ROUND-ROBIN, scheduling-priority=12
