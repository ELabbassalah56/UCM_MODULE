AUTOSAR XML (schema 00047)
package /ara/apd/ucm/mapping
  process to machine mapping set DevelopmentMachineMappings
    process to machine mapping PackageManagerToMachineMapping: machine=DevelopmentMachine, process=package_manager
  someip service instance to machine mapping ProvidedPackageManagementInstanceToMachineMapping: communication-connector=EthCommunicationConnector, service-instance=ProvidedSomeIpPackageManagementInstance, udp-port=5000
  service instance to port prototype mapping ProvidedPackageManagementInstanceToPortMapping: port-prototype=package_manager_root.PackageManagementPPort, process=package_manager, service-instance=ProvidedSomeIpPackageManagementInstance
