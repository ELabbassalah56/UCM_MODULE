AUTOSAR XML (schema 00047)
package /ara/apd/ucm/instance
  provided someip service instance ProvidedSomeIpPackageManagementInstance: service-interface=PackageManagementSomeIp, sd-server-config=SomeipServerServiceInstanceConfig, service-instance-id=828
    someip provided event group CurrentStatus_provided_eventgroup: event-group=CurrentStatus_eventgroup, multicast-threshold=0
