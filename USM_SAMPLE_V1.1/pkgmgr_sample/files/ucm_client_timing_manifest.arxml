AUTOSAR XML (schema 00047)
package /ara/apd/ucm_client/timing
  someip sd client service instance config SomeipClientServiceInstanceConfig: initial-find-behavior={initial-delay-max-value=0.1, initial-delay-min-value=0.01, initial-repetitions-base-delay=0.2, initial-repetitions-max=3}, service-find-time-to-live=10
