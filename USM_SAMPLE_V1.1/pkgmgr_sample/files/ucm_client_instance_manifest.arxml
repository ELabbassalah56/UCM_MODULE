AUTOSAR XML (schema 00047)
package /ara/apd/ucm_client/instance
  required someip service instance RequiredSomeIpPackageManagementInstance: service-interface=PackageManagementSomeIp, required-minor-version=0, required-service-instance-id=ANY, sd-client-config=SomeipClientServiceInstanceConfig
    someip required event group CurrentStatus_required_eventgroup: event-group=CurrentStatus_eventgroup
