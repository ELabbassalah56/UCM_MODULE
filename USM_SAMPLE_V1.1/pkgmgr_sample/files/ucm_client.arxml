AUTOSAR XML (schema 00047)
package /ara/apd/ucm_client/executables
  executable pkgmgr_app: version=1.0.0.0
    root sw component prototype pkgmgr_app_root: application-type=PackageManagerSample
package /ara/apd/ucm_client/processes
  process pkgmgr_sample: executable=pkgmgr_app
package /ara/apd/ucm_client/software_components
  adaptive application sw component type PackageManagerSample
    require port PackageManagementRPort: required-interface=PackageManagement
