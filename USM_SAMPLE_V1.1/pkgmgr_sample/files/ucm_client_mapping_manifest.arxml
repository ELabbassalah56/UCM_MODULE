AUTOSAR XML (schema 00047)
package /ara/apd/ucm_client/mapping
  someip service instance to machine mapping RequiredPackageManagementInstanceToMachineMapping: communication-connector=EthCommunicationConnector, service-instance=RequiredSomeIpPackageManagementInstance, udp-port=5000
  service instance to port prototype mapping RequiredPackageManagementInstanceToPortMapping: port-prototype=pkgmgr_app_root.PackageManagementRPort, process=pkgmgr_sample, service-instance=RequiredSomeIpPackageManagementInstance
