AUTOSAR XML (schema 00045)
package /ara/ucm/datatypes/extensions
  30 x implementation data type extension:
    ActionTypeExt: implementation-data-type=ActionType
      namespaces:
        symbol props ara
        symbol props ucm
        symbol props pkgmgr
    ActivateOptionTypeExt: implementation-data-type=ActivateOptionType
      namespaces:
        symbol props ara
        symbol props ucm
        symbol props pkgmgr
    ActivateReturnTypeExt: implementation-data-type=ActivateReturnType
      namespaces:
        symbol props ara
        symbol props ucm
        symbol props pkgmgr
    ByteVectorTypeExt: implementation-data-type=ByteVectorType
      namespaces:
        symbol props ara
        symbol props ucm
        symbol props pkgmgr
    CancelReturnTypeExt: implementation-data-type=CancelReturnType
      namespaces:
        symbol props ara
        symbol props ucm
        symbol props pkgmgr
    FinishReturnTypeExt: implementation-data-type=FinishReturnType
      namespaces:
        symbol props ara
        symbol props ucm
        symbol props pkgmgr
    GeneralResponseTypeExt: implementation-data-type=GeneralResponseType
      namespaces:
        symbol props ara
        symbol props ucm
        symbol props pkgmgr
    GetHistoryTypeExt: implementation-data-type=GetHistoryType
      namespaces:
        symbol props ara
        symbol props ucm
        symbol props pkgmgr
    GetHistoryVectorTypeExt: implementation-data-type=GetHistoryVectorType
      namespaces:
        symbol props ara
        symbol props ucm
        symbol props pkgmgr
    LogEntryTypeExt: implementation-data-type=LogEntryType
      namespaces:
        symbol props ara
        symbol props ucm
        symbol props pkgmgr
    LogLevelTypeExt: implementation-data-type=LogLevelType
      namespaces:
        symbol props ara
        symbol props ucm
        symbol props pkgmgr
    LogVectorTypeExt: implementation-data-type=LogVectorType
      namespaces:
        symbol props ara
        symbol props ucm
        symbol props pkgmgr
    PackageManagerStatusTypeExt: implementation-data-type=PackageManagerStatusType
      namespaces:
        symbol props ara
        symbol props ucm
        symbol props pkgmgr
    ProcessResultTypeExt: implementation-data-type=ProcessResultType
      namespaces:
        symbol props ara
        symbol props ucm
        symbol props pkgmgr
    ProcessSwPackageReturnTypeExt: implementation-data-type=ProcessSwPackageReturnType
      namespaces:
        symbol props ara
        symbol props ucm
        symbol props pkgmgr
    ResolutionTypeExt: implementation-data-type=ResultType
      namespaces:
        symbol props ara
        symbol props ucm
        symbol props pkgmgr
    RevertProcessedSwPackagesReturnTypeExt: implementation-data-type=RevertProcessedSwPackagesReturnType
      namespaces:
        symbol props ara
        symbol props ucm
        symbol props pkgmgr
    RollbackReturnTypeExt: implementation-data-type=RollbackReturnType
      namespaces:
        symbol props ara
        symbol props ucm
        symbol props pkgmgr
    SwClusterInfoStateTypeExt: implementation-data-type=SwClusterStateType
      namespaces:
        symbol props ara
        symbol props ucm
        symbol props pkgmgr
    SwClusterInfoTypeExt: implementation-data-type=SwClusterInfoType
      namespaces:
        symbol props ara
        symbol props ucm
        symbol props pkgmgr
    SwClusterInfoVectorTypeExt: implementation-data-type=SwClusterInfoVectorType
      namespaces:
        symbol props ara
        symbol props ucm
        symbol props pkgmgr
    SwInfoNameExt: implementation-data-type=SwInfoName
      namespaces:
        symbol props ara
        symbol props ucm
        symbol props pkgmgr
    SwPackageInfoStateTypeExt: implementation-data-type=SwPackageStateType
      namespaces:
        symbol props ara
        symbol props ucm
        symbol props pkgmgr
    SwPackageInfoTypeExt: implementation-data-type=SwPackageInfoType
      namespaces:
        symbol props ara
        symbol props ucm
        symbol props pkgmgr
    SwPackageInfoVectorTypeExt: implementation-data-type=SwPackageInfoVectorType
      namespaces:
        symbol props ara
        symbol props ucm
        symbol props pkgmgr
    TransferDataReturnTypeExt: implementation-data-type=TransferDataReturnType
      namespaces:
        symbol props ara
        symbol props ucm
        symbol props pkgmgr
    TransferExitReturnTypeExt: implementation-data-type=TransferExitReturnType
      namespaces:
        symbol props ara
        symbol props ucm
        symbol props pkgmgr
    TransferIdTypeExt: implementation-data-type=TransferIdType
      namespaces:
        symbol props ara
        symbol props ucm
        symbol props pkgmgr
    TransferStartReturnTypeExt: implementation-data-type=TransferStartReturnType
      namespaces:
        symbol props ara
        symbol props ucm
        symbol props pkgmgr
    TransferStartSuccessTypeExt: implementation-data-type=TransferStartSuccessType
      namespaces:
        symbol props ara
        symbol props ucm
        symbol props pkgmgr
package /ara/ucm/datatypes/implementationdatatypes
  30 x impl type:
    ActionType: compu {0=kUpdate, 1=kInstall, 2=kRemove}, implementation-data-type=UInt8
    ActivateOptionType: compu {0=kDefault, 1=kFunctionGroupRestart, 2=kSystemReset}, implementation-data-type=UInt8
    ActivateReturnType: compu {0=kSuccess, 1=kErrorNoProcessedPackages, 2=kErrorDuringActivation, 3=kErrorNoValidProcessing, 4=kMissingDependencies}, implementation-data-type=UInt8
    ByteVectorType: implementation-data-type=ByteArray
    CancelReturnType: compu {0=kSuccess, 1=kError, 2=kOperationNotPermitted}, implementation-data-type=UInt8
    FinishReturnType: compu {0=kSuccess, 1=kUndefinedError, 2=kOperationNotPermitted}, implementation-data-type=UInt8
    GeneralResponseType: compu {0=kSuccess, 1=kGeneralReject, 2=kGeneralMemoryError, 3=kTransferIdInvalid, 4=kOperationNotPermitted}, implementation-data-type=UInt8
    GetHistoryType: category=STRUCTURE
      5 x element, all with category=TYPE_REFERENCE:
        Time: implementation-data-type=UInt64
        Name: implementation-data-type=SwInfoName
        Version: implementation-data-type=String
        Action: implementation-data-type=ActionType
        Resolution: implementation-data-type=ResultType
    GetHistoryVectorType: category=VECTOR
      element GetHistoryElement: implementation-data-type=GetHistoryType
    LogEntryType: category=STRUCTURE
      element LogLevel: implementation-data-type=LogLevelType
      element Message: implementation-data-type=String
    LogLevelType: compu {0=kOff, 1=kFatal, 2=kError, 3=kWarning, 4=kInfo, 5=kDebug, 6=kVerbose}, implementation-data-type=UInt8
    LogVectorType: category=VECTOR
      element LogEntryElement: implementation-data-type=LogEntryType
    PackageManagerStatusType: compu {0=kReady, 1=kProcessing, 2=kActivating, 3=kCleaningUp, 4=kActivated, 5=kRolledBack, 6=kRollingBack, 7=kVerifying}, implementation-data-type=UInt8
    ProcessResultType: compu {0=kSuccess, 1=kReject, 2=kInvalidManifest, 3=kPackageInconsistent, 4=kInsufficientMemory, 5=kInvalidTransferId, 6=kOperationNotPermitted}, implementation-data-type=UInt8
    ProcessSwPackageReturnType: category=STRUCTURE
      element result: implementation-data-type=ProcessResultType
      element transferId: implementation-data-type=TransferIdType
    ResultType: compu {0=kSuccessfull, 1=kFailed}, implementation-data-type=UInt8
    RevertProcessedSwPackagesReturnType: compu {0=kSuccess, 1=kNothingToRevert, 2=kNotAbleToRevertPackages}, implementation-data-type=UInt8
    RollbackReturnType: compu {0=kSuccess, 1=kNothingToRollback, 2=kNotAbleToRollback}, implementation-data-type=UInt8
    SwClusterInfoType: category=STRUCTURE
      element Name: implementation-data-type=SwInfoName
      element Version: implementation-data-type=String
      element State: implementation-data-type=SwClusterStateType
    SwClusterInfoVectorType: category=VECTOR
      element SwClusterInfoElement: implementation-data-type=SwClusterInfoType
    SwClusterStateType: compu {0=kPresent, 1=kAdded, 2=kUpdated, 3=kRemoved}, implementation-data-type=UInt8
    SwInfoName: category=STRING, implementation-data-type=String
    SwPackageInfoType: category=STRUCTURE
      4 x element, all with category=TYPE_REFERENCE:
        Name: implementation-data-type=SwInfoName
        Version: implementation-data-type=String
        TransferID: implementation-data-type=TransferIdType
        State: implementation-data-type=SwPackageStateType
    SwPackageInfoVectorType: category=VECTOR
      element SwPackageInfoElement: implementation-data-type=SwPackageInfoType
    SwPackageStateType: compu {0=kTransferring, 1=kTransferred, 2=kProcessing}, implementation-data-type=UInt8
    TransferDataReturnType: compu {0=kSuccess, 1=kIncorrectBlock, 2=kIncorrectSize, 3=kInsufficientMemory, 4=kInvalidTransferId, 5=kOperationNotPermitted}, implementation-data-type=UInt8
    TransferExitReturnType: compu {0=kSuccess, 1=kInsufficientData, 2=kPackageInconsistent, 3=kInvalidTransferId, 4=kOperationNotPermitted}, implementation-data-type=UInt8
    TransferIdType: category=VALUE, base-type=std_uint64_t
    TransferStartReturnType: category=STRUCTURE
      element TransferId: implementation-data-type=TransferIdType
      element TransferStartSuccess: implementation-data-type=TransferStartSuccessType
    TransferStartSuccessType: compu {0=kSuccess, 1=kInsufficientMemory}, implementation-data-type=UInt8
package /ara/ucm/pkgmgr/exec
  executable PackageManager_exe
    root sw component prototype PackageManager_root
package /ara/ucm/pkgmgr/portinterfaces
  service interface PackageManagement
    namespaces:
      symbol props ara
      symbol props ucm
      symbol props pkgmgr
    field CurrentStatus: type=PackageManagerStatusType, has-getter=true, has-notifier=true, has-setter=false, init-value=0
    methods:
      17 x operation, all with fire-and-forget=false:
        Activate
          arg result: type=ActivateReturnType, direction=OUT
          arg option: type=ActivateOptionType, direction=IN
        Cancel
          arg id: type=TransferIdType, direction=IN
          arg result: type=CancelReturnType, direction=OUT
        DeleteTransfer
          arg id: type=TransferIdType, direction=IN
          arg result: type=GeneralResponseType, direction=OUT
        Finish
          arg result: type=FinishReturnType, direction=OUT
        GetHistory
          arg history: type=GetHistoryVectorType, direction=OUT
          arg timestampGE: type=UInt64, direction=IN
          arg timestampLT: type=UInt64, direction=IN
        GetLog
          arg id: type=TransferIdType, direction=IN
          arg log: type=LogVectorType, direction=OUT
        GetSwClusterChangeInfo
          arg SwInfo: type=SwClusterInfoVectorType, direction=OUT
        GetSwClusterInfo
          arg SwInfo: type=SwClusterInfoVectorType, direction=OUT
        GetSwPackages
          arg Packages: type=SwPackageInfoVectorType, direction=OUT
        GetSwProcessProgress
          arg id: type=TransferIdType, direction=IN
          arg progress: type=UInt8, direction=OUT
        ProcessSwPackage
          arg id: type=TransferIdType, direction=IN
          arg result: type=ProcessSwPackageReturnType, direction=OUT
        RevertProcessedSwPackages
          arg result: type=RevertProcessedSwPackagesReturnType, direction=OUT
        Rollback
          arg result: type=RollbackReturnType, direction=OUT
        SetLogLevel
          arg id: type=TransferIdType, direction=IN
          arg logLevel: type=LogLevelType, direction=IN
        TransferData
          4 x arg:
            id: type=TransferIdType, direction=IN
            data: type=ByteVectorType, direction=IN
            blockCounter: type=UInt32, direction=IN
            result: type=TransferDataReturnType, direction=OUT
        TransferExit
          arg id: type=TransferIdType, direction=IN
          arg result: type=TransferExitReturnType, direction=OUT
        TransferStart
          arg size: type=UInt64, direction=IN
          arg result: type=TransferStartReturnType, direction=OUT
package /ara/ucm/pkgmgr/processes
  process PackageManager_instance: executable=PackageManager_exe
package /ara/ucm/pkgmgr/swcs
  adaptive application sw component type PackageManager
    provide port PackageManagement: provided-interface=PackageManagement
  composition sw component type ucm
    component PackageManager: type=PackageManager
